
/*	
Konfiguracija sistema:
Pin 2: ulazni pin, dugme
Pinovi 6-14, izlazni pinovi, LED displey
Pinovi 3 i 4, CS* za led displey
*/

int count = 0, time = 0;

void prikaziCifru(int cifra, int pin){
	int i;
	for(i=0; i<4; i++){
		digitalWrite(pin+i, cifra%2);
		cifra /= 2; 
	}
}

void prikazi(int count) {
	prikaziCifru(count%10, 6);
	prikaziCifru((count/10)%10, 10);
}

void dugme() {
	// startuje se na promenu stanja dugmeta
	if (digitalRead(2)==1)
		// ako je dugme upravo pritisnuto
	time = millis();
	else if (millis()-time>1000)
	{
		// ako je dugme upravo pusteno
		count++;
		prikazi(count);
	}      
}

void setup()
{
	pinMode(2, INPUT);
	int i;
	for (i=6; i<14; i++){
		pinMode(i, OUTPUT);
		digitalWrite(i, LOW);
	}
	pinMode(3, OUTPUT);
	digitalWrite(3, LOW);
	pinMode(4, OUTPUT);
	digitalWrite(4, LOW);
	count = 0;
	time = millis();
	// postavljamo interapt, tj. funkciju dugme, 
	// da se izvrsi za svaku promenu stanja dugmeta
	attachInterrupt(0, dugme, CHANGE);
}

void loop()
{
	delay(100);
}
